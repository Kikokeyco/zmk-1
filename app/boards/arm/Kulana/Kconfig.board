## app/boards/arm/Kulana/Kconfig.board
```kconfig
# BOARD_KULANA board configuration

# Copyright (c) 2020 Kagen Aeby (Kikokeyco)
# SPDX-License-Identifier: MIT

config BOARD_BOARD_KULANA
	bool "Kulana"
	depends on SOC_NRF52840_QIAA
```

## app/boards/arm/Kulana/Kconfig.defconfig
```kconfig
# Copyright (c) 2020 Kagen Aeby (Kikokeyco)
# SPDX-License-Identifier: MIT

if BOARD_KULANA

config ZMK_KEYBOARD_NAME
	default "Kulana"

if USB

config USB_NRFX
	default y

config USB_DEVICE_STACK
	default y

endif # USB

config BT_CTLR
	default BT

config ZMK_BLE
	default y

config ZMK_USB
	default y
	
config ZMK_BATTERY_VOLTAGE_DIVIDER
	default y

config ZMK_DISPLAY
	select LVGL_USE_CONT
	select LVGL_FONT_MONTSERRAT_26
	select LVGL_FONT_MONTSERRAT_20
	select LVGL_FONT_MONTSERRAT_16
	select LVGL_USE_LABEL
	select LVGL_USE_IMG

choice ZMK_DISPLAY_STATUS_SCREEN
	default ZMK_DISPLAY_STATUS_SCREEN_CUSTOM
endchoice

if ZMK_DISPLAY

config SPI
	default y

config IL0323
	bool
	default y

#config DISPLAY_WOB
#	bool "White on Black Display"
#	default n


endif # ZMK_DISPLAY

if LVGL

config LVGL_HOR_RES_MAX
	default 128

config LVGL_VER_RES_MAX
	default 32

config LVGL_VDB_SIZE
	default 64

config LVGL_DPI
	default 148

config LVGL_BITS_PER_PIXEL
	default 1

choice LVGL_COLOR_DEPTH
	default LVGL_COLOR_DEPTH_1
endchoice

endif # LVGL

if ZMK_BACKLIGHT

config PWM
    default y

config LED_PWM
    default y

endif # ZMK_BACKLIGHT

endif # BOARD_KULANA
```

## app/boards/arm/Kulana/Kulana_defconfig
```kconfig
# SPDX-License-Identifier: MIT

CONFIG_SOC_SERIES_NRF52X=y
CONFIG_SOC_NRF52840_QIAA=y
CONFIG_BOARD_KULANA=y

# Enable MPU
CONFIG_ARM_MPU=y

# enable GPIO
CONFIG_GPIO=y
CONFIG_USE_DT_CODE_PARTITION=y

CONFIG_MPU_ALLOW_FLASH_WRITE=y
CONFIG_NVS=y  
CONFIG_SETTINGS_NVS=y
CONFIG_FLASH=y
CONFIG_FLASH_PAGE_LAYOUT=y
CONFIG_FLASH_MAP=y

# set TX power level
CONFIG_BT_CTLR_TX_PWR_PLUS_8=y // Recommended if used in a metal enclosure

# Enable Underglow
CONFIG_ZMK_RGB_UNDERGLOW=y
CONFIG_WS2812_STRIP=y
CONFIG_ZMK_RGB_UNDERGLOW_EXT_POWER=y
CONFIG_ZMK_RGB_UNDERGLOW_ON_START=y

# Enable Display
CONFIG_ZMK_DISPLAY=y
CONFIG_SSD1306=n
CONFIG_IL0323=y
CONFIG_LVGL_HOR_RES_MAX=80
CONFIG_LVGL_VER_RES_MAX=128
CONFIG_LVGL_BITS_PER_PIXEL=1
CONFIG_LVGL_COLOR_DEPTH_1=y
CONFIG_LVGL_DPI=145
CONFIG_LVGL_VDB_SIZE=100
CONFIG_LVGL_USE_THEME_MONO=y
CONFIG_LVGL_THEME_DEFAULT_COLOR_PRIMARY_RED=n
CONFIG_LVGL_THEME_DEFAULT_COLOR_SECONDARY_RED=n
CONFIG_LVGL_THEME_DEFAULT_COLOR_PRIMARY_BLACK=y
CONFIG_LVGL_THEME_DEFAULT_COLOR_SECONDARY_WHITE=y
CONFIG_LVGL_THEME_DEFAULT_FONT_SMALL_MONTSERRAT_16=y
CONFIG_LVGL_THEME_DEFAULT_FONT_NORMAL_MONTSERRAT_26=y

# Enable SPI
CONFIG_SPI=y
CONFIG_SPI_2=y
CONFIG_SPI_NRFX=y

# Enable Backlight 
CONFIG_ZMK_BACKLIGHT=y
CONFIG_ZMK_BACKLIGHT_ON_START=y
CONFIG_ZMK_BACKLIGHT_BRT_START=100

CONFIG_ZMK_SLEEP=y
CONFIG_BUILD_OUTPUT_UF2=y
```

## app/boards/arm/Oumuamua/Kconfig.board
```kconfig
# OUMUAMUA board configuration

# Copyright (c) 2020 Kagen Aeby (Kikokeyco)
# SPDX-License-Identifier: MIT

config BOARD_OUMUAMUA
	bool "OUMUAMUA"
	depends on SOC_NRF52840_QIAA
```

## app/boards/arm/Polani/Kconfig.board
```kconfig
# Polani board configuration

# Copyright (c) 2020 Kagen Aeby (Kikokeyco)
# SPDX-License-Identifier: MIT

config BOARD_POLANI
	bool "Polani"
	depends on SOC_NRF52840_QIAA
```

## app/boards/arm/Polani2/Kconfig.board
```kconfig
# Polani2 board configuration

# Copyright (c) 2020 Kagen Aeby (Kikokeyco)
# SPDX-License-Identifier: MIT

config BOARD_POLANI2
	bool "Polani2"
	depends on SOC_NRF52840_QIAA
```

## app/boards/arm/Polani3/Kconfig.board
```kconfig
# Polani3 board configuration

# Copyright (c) 2020 Kagen Aeby (Kikokeyco)
# SPDX-License-Identifier: MIT

config BOARD_POLANI3
	bool "Polani3"
	depends on SOC_NRF52840_QIAA
```

## app/boards/arm/Poldlani/Kconfig.board
```kconfig
# Poldani board configuration

# Copyright (c) 2020 Kagen Aeby (Kikokeyco)
# SPDX-License-Identifier: MIT

config BOARD_POLDANI
	bool "Poldani"
	depends on SOC_NRF52840_QIAA
```
